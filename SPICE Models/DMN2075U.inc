*---------- DMN2075U Spice Model ----------
.SUBCKT DMN2075U 10 20 30 
*     TERMINALS:  D  G  S
M1 1 2 3 3 NMOS L = 1E-006 W = 1E-006 
RD 10 1 0.03596 
RS 30 3 0.001 
RG 20 2 1.5 
CGS 2 3 5.381E-010 
EGD 12 0 2 1 1 
VFB 14 0 0 
FFB 2 1 VFB 1 
CGD 13 14 7E-010 
R1 13 0 1 
D1 12 13 DLIM 
DDG 15 14 DCGD 
R2 12 15 1 
D2 15 0 DLIM 
DSD 3 10 DSUB 
.MODEL NMOS NMOS LEVEL = 3 VMAX = 5.378E+005 ETA = 0.001 VTO = 0.9505 
+ TOX = 6E-008 NSUB = 1E+016 KP = 55.47 U0 = 400 KAPPA = 10 
.MODEL DCGD D CJO = 3.128E-010 VJ = 0.6 M = 0.6001 
.MODEL DSUB D IS = 4.456E-010 N = 1.107 RS = 0.06698 BV = 22 CJO = 1E-015 VJ = 0.6 M = 0.7957 
.MODEL DLIM D IS = 0.0001 
.ENDS
*Diodes DMN2075U Spice Model v1.0M Last Revised 2016/4/7